## sdkconfig.defaults
```kconfig
CONFIG_APP_PROJECT_VER_FROM_CONFIG=y
CONFIG_APP_PROJECT_VER="1.2.0"
CONFIG_BOOTLOADER_APP_ROLLBACK_ENABLE=y
CONFIG_ESPTOOLPY_FLASHSIZE_8MB=y
CONFIG_PARTITION_TABLE_CUSTOM=y
CONFIG_ESP32S3_DEFAULT_CPU_FREQ_240=y
CONFIG_ETH_SPI_ETHERNET_W5500=y
# CONFIG_ESP_HTTP_CLIENT_ENABLE_HTTPS is not set
# CONFIG_ESP_HTTP_CLIENT_ENABLE_DIGEST_AUTH is not set
CONFIG_HTTPD_MAX_REQ_HDR_LEN=2048
# CONFIG_ESP_PHY_CALIBRATION_AND_DATA_STORAGE is not set
# CONFIG_PM_POWER_DOWN_CPU_IN_LIGHT_SLEEP is not set
# CONFIG_ESP32_WIFI_NVS_ENABLED is not set
CONFIG_FREERTOS_HZ=200
CONFIG_FREERTOS_TIMER_TASK_STACK_DEPTH=4096
CONFIG_LWIP_LOCAL_HOSTNAME="rcs"
```

## software/config/Kconfig
```kconfig
menu "Raffstore Control System"
    choice
        bool "Active configuration profile"
        default RCS_ACTIVE_PROFILE_DEFAULT

        config RCS_ACTIVE_PROFILE_DEFAULT
            bool "Default"
        config RCS_ACTIVE_PROFILE_RCSEG
            bool "RCS-EG"
        config RCS_ACTIVE_PROFILE_RCSOG
            bool "RCS-OG"
    endchoice

    config RCS_ACTIVE_PROFILE
        string
        default "config/profiles/default.h" if RCS_ACTIVE_PROFILE_DEFAULT
        default "config/profiles/rcseg.h" if RCS_ACTIVE_PROFILE_RCSEG
        default "config/profiles/rcsog.h" if RCS_ACTIVE_PROFILE_RCSOG
endmenu
```
